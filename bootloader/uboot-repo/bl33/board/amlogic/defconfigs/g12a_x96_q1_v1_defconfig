## bootloader/uboot-repo/bl33/board/amlogic/defconfigs/g12a_x96_q1_v1_defconfig
```kconfig
CONFIG_ARM=y
CONFIG_TARGET_MESON_G12A=y
CONFIG_XINGYI_X96_Q1=y
CONFIG_DM=y
CONFIG_DM_GPIO=y
CONFIG_AML_GPIO=y
```
