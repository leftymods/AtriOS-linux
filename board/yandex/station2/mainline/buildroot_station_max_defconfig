## board/yandex/station2/mainline/buildroot_station_max_defconfig
```kconfig
BR2_aarch64=y
BR2_TOOLCHAIN_EXTERNAL=y
BR2_TOOLCHAIN_EXTERNAL_BOOTLIN=y
BR2_TOOLCHAIN_EXTERNAL_BOOTLIN_AARCH64_GLIBC_STABLE=y
BR2_TARGET_GENERIC_HOSTNAME="AtriOS"
BR2_TARGET_GENERIC_ISSUE="Welcome to AtriOS Nebula [Yandex Station Max S905X3]"
BR2_TARGET_GENERIC_GETTY_PORT="ttyAML0"
BR2_ROOTFS_OVERLAY="../board/yandex/station2/rootfs_overlay"
BR2_PACKAGE_BUSYBOX_SHOW_OTHERS=y
BR2_PACKAGE_ALSA_UTILS=y
BR2_PACKAGE_ALSA_UTILS_AMIXER=y
BR2_PACKAGE_ALSA_UTILS_APLAY=y
BR2_PACKAGE_ALSA_UTILS_SPEAKER_TEST=y
BR2_PACKAGE_BLUEZ_ALSA=y
BR2_PACKAGE_PIPEWIRE=y
BR2_PACKAGE_WIREPLUMBER=y
BR2_PACKAGE_EVTEST=y
BR2_PACKAGE_I2C_TOOLS=y
BR2_PACKAGE_LUA=y
BR2_PACKAGE_PYTHON3=y
BR2_PACKAGE_PCRE2_32=y
BR2_PACKAGE_BLUEZ5_UTILS_TOOLS=y
BR2_PACKAGE_BLUEZ5_UTILS_DEPRECATED=y
BR2_PACKAGE_DROPBEAR=y
BR2_PACKAGE_IW=y
BR2_PACKAGE_WIRELESS_TOOLS=y
BR2_PACKAGE_WPA_SUPPLICANT=y
BR2_PACKAGE_WPA_SUPPLICANT_CLI=y
BR2_PACKAGE_HTOP=y
BR2_PACKAGE_KMOD=y
BR2_TARGET_ROOTFS_EXT2=y
BR2_TARGET_ROOTFS_EXT2_4=y
BR2_TARGET_ROOTFS_EXT2_SIZE="1024M"
```

## board/yandex/station2/mainline/linux_7.0_station_max_defconfig
```kconfig
#
# Linux Kernel 7.0 Defconfig for Yandex Station Max (SM1 / S905X3)
#
CONFIG_SYSVIPC=y
CONFIG_POSIX_MQUEUE=y
CONFIG_NO_HZ_IDLE=y
CONFIG_HIGH_RES_TIMERS=y
CONFIG_PREEMPT=y
CONFIG_IKCONFIG=y
CONFIG_IKCONFIG_PROC=y
CONFIG_LOG_BUF_SHIFT=17
CONFIG_CGROUPS=y
CONFIG_BLK_DEV_INITRD=y
CONFIG_EMBEDDED=y
CONFIG_ARCH_MESON=y
CONFIG_ARM64_VA_BITS_48=y
CONFIG_SCHED_MC=y
CONFIG_NR_CPUS=4
CONFIG_COMPAT=y
CONFIG_ARMV8_DEPRECATED=y
CONFIG_SWP_EMULATION=y
CONFIG_CP15_BARRIER_EMULATION=y
CONFIG_SETEND_EMULATION=y
CONFIG_ARM64_SW_TTBR0_PAN=y
CONFIG_RANDOMIZE_BASE=y
CONFIG_CPU_FREQ=y
CONFIG_CPU_FREQ_STAT=y
CONFIG_CPU_FREQ_DEFAULT_GOV_ONDEMAND=y
CONFIG_CPU_FREQ_GOV_PERFORMANCE=y
CONFIG_CPU_FREQ_GOV_POWERSAVE=y
CONFIG_CPU_FREQ_GOV_USERSPACE=y
CONFIG_CPU_FREQ_GOV_CONSERVATIVE=y
CONFIG_CPU_FREQ_GOV_SCHEDUTIL=y
CONFIG_ARM_SCPI_CPUFREQ=y
CONFIG_ARM_SCPI_POWER_DOMAIN=y
CONFIG_ARM_SCMI_PROTOCOL=y
CONFIG_ARM_SCMI_POWER_DOMAIN=y
CONFIG_COMMON_CLK_SCPI=y
CONFIG_COMMON_CLK_SCMI=y
CONFIG_NET=y
CONFIG_PACKET=y
CONFIG_UNIX=y
CONFIG_INET=y
CONFIG_IP_MULTICAST=y
CONFIG_IP_ADVANCED_ROUTER=y
CONFIG_IP_PNP=y
CONFIG_IP_PNP_DHCP=y
CONFIG_IP_PNP_BOOTP=y
CONFIG_BT=y
CONFIG_BT_RFCOMM=y
CONFIG_BT_BNEP=y
CONFIG_BT_HIDP=y
CONFIG_BT_HCIUART=y
CONFIG_BT_HCIUART_H4=y
CONFIG_BT_HCIUART_BCM=y
CONFIG_BT_HCIUART_RTL=y
CONFIG_CFG80211=y
CONFIG_MAC80211=y
CONFIG_DEVTMPFS=y
CONFIG_DEVTMPFS_MOUNT=y
CONFIG_OF_OVERLAY=y
CONFIG_OF_CONFIGFS=y
CONFIG_BLK_DEV_LOOP=y
CONFIG_BLK_DEV_RAM=y
CONFIG_BLK_DEV_RAM_SIZE=16384
CONFIG_SCSI=y
CONFIG_BLK_DEV_SD=y
CONFIG_NETDEVICES=y
CONFIG_ETHERNET=y
CONFIG_STMMAC_ETH=y
CONFIG_DWMAC_MESON=y
CONFIG_MDIO_BUS=y
CONFIG_AMLOGIC_G12A_MDIO_MUX=y
CONFIG_MESON_G12A_ANALOG_PE_PHY=y
CONFIG_WLAN=y
CONFIG_WLAN_VENDOR_REALTEK=y
CONFIG_RTW88=m
CONFIG_RTW88_8822C=m
CONFIG_RTW88_8822CS=m
CONFIG_INPUT_EVDEV=y
CONFIG_KEYBOARD_GPIO=y
CONFIG_INPUT_MISC=y
CONFIG_INPUT_UINPUT=y
CONFIG_SERIAL_AMLOGIC=y
CONFIG_SERIAL_AMLOGIC_CONSOLE=y
CONFIG_I2C=y
CONFIG_I2C_CHARDEV=y
CONFIG_I2C_MESON=y
CONFIG_SPI=y
CONFIG_SPI_MESON_SPICC=y
CONFIG_SPI_SPIDEV=y
CONFIG_PINCTRL_MESON_G12A=y
CONFIG_GPIOLIB=y
CONFIG_GPIO_SYSFS=y
CONFIG_POWER_RESET=y
CONFIG_POWER_RESET_SYSCON=y
CONFIG_POWER_RESET_SYSCON_POWEROFF=y
CONFIG_POWER_SUPPLY=y
CONFIG_THERMAL=y
CONFIG_THERMAL_GOV_STEP_WISE=y
CONFIG_CPU_THERMAL=y
CONFIG_AMLOGIC_THERMAL=y
CONFIG_WATCHDOG=y
CONFIG_MESON_GXBB_WATCHDOG=y
CONFIG_REGULATOR=y
CONFIG_REGULATOR_FIXED_VOLTAGE=y
CONFIG_REGULATOR_PWM=y
CONFIG_MEDIA_SUPPORT=y
CONFIG_DRM=y
CONFIG_DRM_MESON=y
CONFIG_DRM_MESON_DW_HDMI=y
CONFIG_DRM_PANEL_SIMPLE=y
CONFIG_FB=y
CONFIG_FB_BACKLIGHT=y
CONFIG_BACKLIGHT_CLASS_DEVICE=y
CONFIG_BACKLIGHT_PWM=y
CONFIG_SOUND=y
CONFIG_SND=y
CONFIG_SND_SOC=y
CONFIG_SND_SOC_MESON_AXG_SOUND_CARD=y
CONFIG_SND_SOC_MESON_AXG_TDM_FORMATTER=y
CONFIG_SND_SOC_MESON_AXG_TDM_INTERFACE=y
CONFIG_SND_SOC_MESON_AXG_FRDDR=y
CONFIG_SND_SOC_MESON_AXG_TODDR=y
CONFIG_SND_SOC_MESON_G12A_TOHDMITX=y
CONFIG_SND_SOC_MESON_T9015=y
CONFIG_HID_GENERIC=y
CONFIG_USB=y
CONFIG_USB_ANNOUNCE_NEW_DEVICES=y
CONFIG_USB_XHCI_HCD=y
CONFIG_USB_XHCI_MESON_G12A=y
CONFIG_USB_STORAGE=y
CONFIG_USB_DWC3=y
CONFIG_USB_DWC3_MESON_G12A=y
CONFIG_USB_DWC2=y
CONFIG_MMC=y
CONFIG_MMC_BLOCK=y
CONFIG_MMC_MESON_GX=y
CONFIG_NEW_LEDS=y
CONFIG_LEDS_CLASS=y
CONFIG_LEDS_TRIGGERS=y
CONFIG_RTC_CLASS=y
CONFIG_RTC_DRV_PCF8563=y
CONFIG_DMADEVICES=y
CONFIG_IIO=y
CONFIG_PWM=y
CONFIG_PWM_MESON=y
CONFIG_RESET_CONTROLLER=y
CONFIG_RESET_MESON=y
CONFIG_PHY_MESON_G12A_USB2=y
CONFIG_PHY_MESON_G12A_USB3_PCIE=y
CONFIG_EXT4_FS=y
CONFIG_EXT4_FS_POSIX_ACL=y
CONFIG_AUTOFS4_FS=y
CONFIG_FUSE_FS=y
CONFIG_VFAT_FS=y
CONFIG_TMPFS=y
CONFIG_TMPFS_POSIX_ACL=y
CONFIG_CONFIGFS_FS=y
CONFIG_NLS_CODEPAGE_437=y
CONFIG_NLS_ISO8859_1=y
CONFIG_CRYPTO_USER=y
CONFIG_CRYPTO_SHA1=y
CONFIG_CRYPTO_SHA256=y
CONFIG_CRYPTO_AES=y
CONFIG_PRINTK_TIME=y
# Yandex Station Max hardware modules
CONFIG_YANDEX_GOWIN_LED_DEVICE=m
CONFIG_YANDEX_QUASAR_LED_SCREEN=m
CONFIG_YANDEX_QUASAR_LED_RING=m
CONFIG_YANDEX_QUASAR_PCBA_IDS=m
CONFIG_YANDEX_ROTARY_VOLUME=m
CONFIG_YANDEX_GPIO_KEYPAD=m
CONFIG_YANDEX_ZIGBEE_CONTROL=m
CONFIG_YANDEX_LTR308ALS01=m
CONFIG_YANDEX_LEDS_IS31FL32XX=m
CONFIG_YANDEX_SND_SOC_SY6045S=m
CONFIG_YANDEX_SND_SOC_ES8156=m
CONFIG_YANDEX_SND_SOC_ES7210=m
CONFIG_YANDEX_SND_SOC_TAS5825M=m
CONFIG_LOCALVERSION="-AtriOS-aml"
CONFIG_DEFAULT_HOSTNAME=AtriOS
CONFIG_MODULES=y
CONFIG_MODULE_UNLOAD=y
CONFIG_MODVERSIONS=y
```

## board/yandex/station2/mainline/uboot_station_max_defconfig
```kconfig
#
# Mainline U-Boot Defconfig for Yandex Station Max (SM1 / S905X3)
# Based on configs/sei610_defconfig & configs/khadas-vim3l_defconfig
#
CONFIG_ARM=y
CONFIG_SYS_BOARD="station_max"
CONFIG_SYS_CONFIG_NAME="meson64"
CONFIG_ARCH_MESON=y
CONFIG_TEXT_BASE=0x01000000
CONFIG_NR_DRAM_BANKS=1
CONFIG_ENV_SIZE=0x2000
CONFIG_ENV_OFFSET=0xffff0000
CONFIG_DM_GPIO=y
CONFIG_DEFAULT_DEVICE_TREE="meson-sm1-yandex-station-max"
CONFIG_MESON_SM1=y
CONFIG_SYS_PROMPT="AtriOS-aml# "
CONFIG_SYS_LOAD_ADDR=0x1000000
CONFIG_IDENT_STRING=" AtriOS-aml (by leftymods)"
CONFIG_OF_BOARD_SETUP=y
CONFIG_USE_PREBOOT=y
CONFIG_PREBOOT="run load_logo; usb start;"
# CONFIG_DISPLAY_CPUINFO is not set
# CONFIG_DISPLAY_BOARDINFO is not set
CONFIG_MISC_INIT_R=y
# CONFIG_CMD_BDI is not set
CONFIG_CMD_NVEDIT_EFI=y
# CONFIG_CMD_IMI is not set
CONFIG_CMD_DFU=y
CONFIG_CMD_GPIO=y
CONFIG_CMD_GPT=y
CONFIG_CMD_I2C=y
CONFIG_CMD_MMC=y
CONFIG_CMD_SPI=y
CONFIG_CMD_USB=y
CONFIG_CMD_USB_MASS_STORAGE=y
# CONFIG_CMD_SETEXPR is not set
CONFIG_CMD_REGULATOR=y
CONFIG_OF_CONTROL=y
CONFIG_SYS_RELOC_GD_ENV_ADDR=y
CONFIG_NET_RANDOM_ETHADDR=y
CONFIG_SARADC_MESON=y
CONFIG_BUTTON=y
CONFIG_BUTTON_ADC=y
CONFIG_DM_I2C=y
CONFIG_SYS_I2C_MESON=y
CONFIG_MMC_MESON_GX=y
CONFIG_PHY_REALTEK=y
CONFIG_DM_ETH_PHY=y
CONFIG_ETH_DESIGNWARE_MESON8B=y
CONFIG_MESON_G12A_USB_PHY=y
CONFIG_PINCTRL_MESON_G12A=y
CONFIG_POWER_DOMAIN=y
CONFIG_MESON_EE_POWER_DOMAIN=y
CONFIG_DM_REGULATOR=y
CONFIG_DM_REGULATOR_FIXED=y
CONFIG_DM_RESET=y
CONFIG_DEBUG_UART_ANNOUNCE=y
CONFIG_DEBUG_UART_SKIP_INIT=y
CONFIG_MESON_SERIAL=y
CONFIG_SPI=y
CONFIG_DM_SPI=y
CONFIG_MESON_SPICC=y
CONFIG_SYSINFO=y
CONFIG_SYSINFO_SMBIOS=y
CONFIG_USB=y
CONFIG_DM_USB_GADGET=y
CONFIG_USB_XHCI_HCD=y
CONFIG_USB_XHCI_DWC3=y
CONFIG_USB_XHCI_DWC3_OF_SIMPLE=y
CONFIG_USB_DWC3=y
CONFIG_USB_DWC3_GENERIC=y
CONFIG_USB_GADGET=y
CONFIG_USB_GADGET_VENDOR_NUM=0x1b8e
CONFIG_USB_GADGET_PRODUCT_NUM=0xfada
CONFIG_USB_GADGET_DWC2_OTG=y
CONFIG_USB_GADGET_DOWNLOAD=y
CONFIG_DFU_RAM=y
CONFIG_VIDEO=y
# CONFIG_VIDEO_SET_OPTIONS is not set
CONFIG_VIDEO_MESON=y
CONFIG_VIDEO_DT_SIMPLEFB=y
CONFIG_BMP_16BPP=y
CONFIG_BMP_24BPP=y
CONFIG_BMP_32BPP=y
CONFIG_OF_LIBFDT_OVERLAY=y
CONFIG_CMD_FASTBOOT=y
CONFIG_USB_FUNCTION_FASTBOOT=y
CONFIG_FASTBOOT=y
CONFIG_FASTBOOT_BUF_ADDR=0x1000000
CONFIG_FASTBOOT_BUF_SIZE=0x10000000
CONFIG_FASTBOOT_FLASH=y
CONFIG_FASTBOOT_FLASH_MMC_DEV=0
CONFIG_FASTBOOT_USB_DEV=0
CONFIG_USB_GADGET_MANUFACTURER="leftymods"
CONFIG_USB_GADGET_PRODUCT_NAME="AtriOS-aml Station Max"
CONFIG_BOOTCOMMAND="if test ${boot_source} = usb; then run update; fi; run aml_burn; run distro_bootcmd;"
```

## board/yandex/station2/station2_defconfig
```kconfig
# Architecture
BR2_aarch64=y
BR2_cortex_a53=y

# System Configuration
BR2_TARGET_GENERIC_HOSTNAME="atrios-stationmax"
BR2_TARGET_GENERIC_ISSUE="Welcome to AtriOS Linux [Yandex Station Max S905X3]"
BR2_ROOTFS_OVERLAY="../board/yandex/station2/rootfs_overlay"
BR2_TARGET_GENERIC_GETTY_PORT="ttyS0"

# Toolchain
BR2_TOOLCHAIN_BUILDROOT_GLIBC=y
# The Station Max runs the stock Amlogic 4.9.113 kernel, so the userspace
# toolchain must be built against 4.9 headers (not Buildroot's default 6.6).
BR2_KERNEL_HEADERS_VERSION=y
BR2_DEFAULT_KERNEL_VERSION="4.9.113"
BR2_PACKAGE_HOST_LINUX_HEADERS_CUSTOM_4_9=y
BR2_TOOLCHAIN_BUILDROOT_CXX=y

# System utilities & Hardware
BR2_PACKAGE_BUSYBOX=y
BR2_PACKAGE_BUSYBOX_SHOW_OTHERS=y
BR2_PACKAGE_KMOD=y
BR2_PACKAGE_EVTEST=y
BR2_PACKAGE_I2C_TOOLS=y
BR2_PACKAGE_HTOP=y
BR2_PACKAGE_PYTHON3=y

# Audio Stack
BR2_PACKAGE_ALSA_LIB=y
BR2_PACKAGE_ALSA_UTILS=y
BR2_PACKAGE_ALSA_UTILS_AMIXER=y
BR2_PACKAGE_ALSA_UTILS_APLAY=y
BR2_PACKAGE_ALSA_UTILS_SPEAKER_TEST=y
BR2_PACKAGE_PIPEWIRE=y
BR2_PACKAGE_LUA=y
BR2_PACKAGE_LUA_5_4=y
BR2_PACKAGE_WIREPLUMBER=y
BR2_PACKAGE_BLUEZ5_UTILS=y
BR2_PACKAGE_BLUEZ5_UTILS_TOOLS=y
BR2_PACKAGE_BLUEZ5_UTILS_DEPRECATED=y

# Wireless & Remote Access
BR2_PACKAGE_DROPBEAR=y
BR2_PACKAGE_WPA_SUPPLICANT=y
BR2_PACKAGE_WPA_SUPPLICANT_CLI=y
BR2_PACKAGE_WIRELESS_TOOLS=y
BR2_PACKAGE_IW=y

# Target Filesystem
BR2_TARGET_ROOTFS_TAR=y
```

## drivers/yandex/Kconfig
```kconfig
# SPDX-License-Identifier: GPL-2.0-only
menu "Yandex Station Max (Amlogic S905X3 / SM1) Hardware Drivers"

config YANDEX_GOWIN_LED_DEVICE
	tristate "Yandex Gowin 25x16 Monochrome LED Matrix Framebuffer"
	depends on FB
	help
	  Virtual RGB888 (24-bpp) framebuffer driver (/dev/fb) for the
	  front 25x16 monochrome LED matrix driven via Gowin FPGA.

config YANDEX_QUASAR_LED_SCREEN
	tristate "Yandex Quasar Gowin FPGA SPI LED Screen Controller"
	depends on SPI && YANDEX_GOWIN_LED_DEVICE
	help
	  SPI driver for the Gowin FPGA LED screen controller on Yandex
	  Station Max, including JTAG SRAM bitstream programming.

config YANDEX_QUASAR_LED_RING
	tristate "Yandex Quasar 24x RGB LED Ring Framebuffer & Trigger"
	depends on FB && LEDS_CLASS && LEDS_TRIGGERS
	help
	  Virtual 24x1 RGB888 framebuffer and LED trigger (led_ring_fb)
	  driving the 72 LED channels (24 RGB LEDs) on top of the speaker.

config YANDEX_QUASAR_PCBA_IDS
	tristate "Yandex Quasar PCBA Revision & Board EEPROM ID Reader"
	depends on I2C
	help
	  Reads Top, Main, and LED board identity/calibration strings from
	  AT24 I2C EEPROMs and exposes them under /sys/devices/platform/pcba_ids/.

config YANDEX_ROTARY_VOLUME
	tristate "Yandex Station Max Quadrature Rotary Volume Encoder"
	depends on INPUT && GPIOLIB
	help
	  Quadrature rotary encoder driver for the top volume ring on
	  Yandex Station Max (GPIOC_7 / GPIOAO_10).

config YANDEX_GPIO_KEYPAD
	tristate "Yandex Station Max Top Buttons GPIO Keypad Driver"
	depends on INPUT && GPIOLIB
	help
	  GPIO/IRQ button driver for Action (KEY_VOICECOMMAND 582) and
	  Mic Mute (KEY_MICMUTE 248) buttons on Yandex Station Max.

config YANDEX_ZIGBEE_CONTROL
	tristate "Yandex Station Max Zigbee Module Power/Reset/Boot GPIO Control"
	depends on GPIOLIB
	help
	  Platform driver managing zb-reset, zb-boot, and zb-power GPIOs
	  for the Zigbee coordinator module on Yandex Station Max.

config YANDEX_LTR308ALS01
	tristate "Lite-On LTR-308ALS-01 Ambient Light Sensor Driver"
	depends on I2C && IIO
	select REGMAP_I2C
	help
	  IIO ambient light sensor driver for the Lite-On LTR-308ALS-01
	  sensor on I2C0 (0x53) of Yandex Station Max.

config YANDEX_LEDS_IS31FL32XX
	tristate "ISSI IS31FL3236A 36-Channel LED Driver (Yandex GVA Extensions)"
	depends on I2C && LEDS_CLASS
	help
	  LED driver for the dual ISSI IS31FL3236A controllers (0x3c, 0x3f)
	  with Yandex GVA global current scaling and do-not-reset extensions.

config YANDEX_SND_SOC_SY6045S
	tristate "Silergy SY6045S Digital Class-D Audio Amplifier Codec"
	depends on I2C && SND_SOC
	help
	  ASoC codec driver for the Silergy SY6045S digital Class-D amplifiers
	  (Tweeters 0x2a, Woofer 0x2b) with DSP EQ/DRC firmware loading.

config YANDEX_SND_SOC_ES8156
	tristate "Everest Semi ES8156 Stereo Headphone DAC Codec"
	depends on I2C && SND_SOC
	select REGMAP_I2C
	help
	  ASoC codec driver for the Everest ES8156 24-bit stereo DAC driving
	  the 3.5mm AUX/headphone output on I2C2 (0x08).

config YANDEX_SND_SOC_ES7210
	tristate "Everest Semi ES7210 4-Channel Microphone Array ADC (TDM Cascade)"
	depends on I2C && SND_SOC
	help
	  ASoC codec driver for the dual cascaded Everest ES7210 4-channel
	  microphone ADCs (0x40, 0x43) providing 8-channel TDM capture.

config YANDEX_SND_SOC_TAS5825M
	tristate "Texas Instruments TAS5825M Digital Class-D Amplifier Codec"
	depends on I2C && SND_SOC
	select REGMAP_I2C
	help
	  ASoC codec driver for the TI TAS5825M amplifier with firmware
	  register profile loader.

endmenu
```

## mainline/u-boot/yandex-station-max_defconfig
```kconfig
CONFIG_ARM=y
CONFIG_SYS_BOARD="yandex-station-max"
CONFIG_ARCH_MESON=y
CONFIG_TEXT_BASE=0x01000000
CONFIG_NR_DRAM_BANKS=1
CONFIG_HAS_CUSTOM_SYS_INIT_SP_ADDR=y
CONFIG_CUSTOM_SYS_INIT_SP_ADDR=0x20000000
CONFIG_ENV_SIZE=0x2000
CONFIG_DM_GPIO=y
CONFIG_OF_UPSTREAM=y
CONFIG_DEFAULT_DEVICE_TREE="amlogic/meson-sm1-yandex-station-max"
CONFIG_OF_LIBFDT_OVERLAY=y
CONFIG_DM_RESET=y
CONFIG_MESON_G12A=y
CONFIG_SYS_LOAD_ADDR=0x1000000
CONFIG_DEBUG_UART_BASE=0xff803000
CONFIG_DEBUG_UART_CLOCK=24000000
CONFIG_IDENT_STRING=" yandex-station-max"
CONFIG_DEBUG_UART=y
CONFIG_REMAKE_ELF=y
CONFIG_FIT=y
CONFIG_OF_BOARD_SETUP=y
# CONFIG_DISPLAY_CPUINFO is not set
CONFIG_MISC_INIT_R=y
CONFIG_SYS_MAXARGS=32
# CONFIG_CMD_BDI is not set
# CONFIG_CMD_IMI is not set
CONFIG_CMD_BOOTI=y
CONFIG_CMD_GPIO=y
# CONFIG_CMD_LOADS is not set
CONFIG_CMD_MMC=y
CONFIG_CMD_PART=y
CONFIG_CMD_REGULATOR=y
CONFIG_CMD_USB=y
CONFIG_CMD_USB_MASS_STORAGE=y
# CONFIG_CMD_SETEXPR is not set
CONFIG_BUTTON=y
CONFIG_BUTTON_GPIO=y
CONFIG_OF_CONTROL=y
CONFIG_ENV_RELOC_GD_ENV_ADDR=y
CONFIG_MMC_MESON_GX=y
CONFIG_PINCTRL=y
CONFIG_PINCTRL_MESON_G12A=y
CONFIG_POWER_DOMAIN=y
CONFIG_MESON_EE_POWER_DOMAIN=y
CONFIG_DM_REGULATOR=y
CONFIG_DM_REGULATOR_FIXED=y
CONFIG_DEBUG_UART_ANNOUNCE=y
CONFIG_DEBUG_UART_SKIP_INIT=y
CONFIG_MESON_SERIAL=y
CONFIG_USB=y
CONFIG_DM_USB_GADGET=y
CONFIG_USB_XHCI_HCD=y
CONFIG_USB_XHCI_DWC3=y
CONFIG_USB_DWC3=y
# CONFIG_USB_DWC3_GADGET is not set
CONFIG_USB_DWC3_MESON_G12A=y
CONFIG_USB_GADGET=y
CONFIG_USB_GADGET_VENDOR_NUM=0x1b8e
CONFIG_USB_GADGET_PRODUCT_NUM=0xfada
CONFIG_USB_GADGET_DWC2_OTG=y
CONFIG_USB_GADGET_DWC2_OTG_PHY_BUS_WIDTH_8=y
CONFIG_USB_GADGET_DOWNLOAD=y
CONFIG_DOS_PARTITION=y
CONFIG_EFI_PARTITION=y
CONFIG_FS_EXT4=y
CONFIG_CMD_FS_GENERIC=y
CONFIG_FS_FAT=y
CONFIG_BOOTSTD_DEFAULTS=y
```
